#include <Arduino.h>
#include <EEPROM.h>
#include <ArduinoJson.h>
#include <WiFi.h>
#include <PubSubClient.h>
#include <ESPAsyncWebServer.h>
#include <AsyncTCP.h>
#include "SPIFFS.h"
// #include <DNSServer.h>
#include <LiquidCrystal.h>

// #include "DHTesp.h"

const int ADC_LUT[4096] = {0,
                           47, 58, 31, 65, 67, 68, 69, 70, 72, 73, 74, 75, 76, 78, 79,
                           80, 82, 83, 85, 86, 88, 89, 90, 92, 93, 95, 96, 97, 98, 99,
                           100, 101, 102, 103, 104, 105, 106, 107, 108, 109, 110, 111, 112, 113, 115,
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                           4039, 4040, 4040, 4041, 4042, 4042, 4043, 4043, 4044, 4045, 4045, 4046, 4046, 4047, 4048};
#define VIN 6206
const int NUM_ROW = 4;                 // So dong keypad
const int NUM_COL = 4;                 // So cot keypad
const unsigned int MQTT_PORT = 1883;   // Port của CloudMQTT TCP
const unsigned int BAUD_RATE = 115200; // Tốc độ giao tiếp UART BAUD_RATE bit/s
const unsigned int CALIBRATION_SAMPLE_INTERVAL = 500;
const unsigned int WAIT_FOR_WIFI_CONNECTION_INTERVAL = 10000;
const unsigned int SEND_PPM_VALUE_INTERVAL = 1000;

const float R5 = 5100;
const float R6 = 10000;
const float RL = 937.89;
const float CLEAN_AIR_RAITO = 9.5;

const char CALIBARAION_SAMPLE_TIMES = 50;
const char MQ_PIN = 34;
const char LED_PIN = 2;
const char SPEAKER_PIN = 4;
const char READ_SAMPLE_INTERVAL = 20;
const char READ_SAMPLE_TIMES = 5;
const char RO_VALUE_ADDRESS = 0;
const char PPMTHRESOLD_VALUE_ADDRESS = 4;
const char IS_WIFI_ADDRESS = 12;
const char SSID_ADDRESS = 80;
const char PASS_ADDRESS = 110;
const char INIT_THRESOLD_ADDRESS = 140;

const unsigned char EEPROM_SIZE = 200;
const char *PARAM_INPUT_1 = "ssid";
const char *PARAM_INPUT_2 = "pass";
const char *MQTT_SERVER = "116.118.48.230"; // ip broker mqtt
const char *MQTT_USER = "doan2";            // Tài khoản đăng nhập broker
const char *MQTT_PWD = "doan2";             // Mật khẩu đăng nhập broker

// Variables to save values from HTML form
String html = "";
String selectSsid = "";

String ssid = "NhanSgu";
String pass = "1";

float Ro = 0;
unsigned long previousMillisAlarm = 0;
unsigned long previousMillis = 0;
unsigned long currentTimeSendPPMval = 0;
unsigned long PPMval = 0;
unsigned long PPMThresold = 1800;
bool isAlarm = false;
bool isWiFi = false;
bool isWiFiDone = false;
bool initThresold = false;

char cstr[255]; // mảng dữ liệu gửi lên broker

const char KEYS[NUM_ROW][NUM_COL] = {
    {'1', '2', '3', '4'},
    {'5', '6', '7', '8'},
    {'9', '0', 'S', 'D'},  // S: Đặt ngưỡng ppm, D: đặt xong bấm nút này để ghi nhận
    {'F', 'W', 'O', 'C'}}; // F: Tìm Ro, W: bật/tắt Wifi, O: Tắt báo động, C: Thay đổi wifi
const char COL_PINS[NUM_COL] = {12, 13, 14, 15};
const char ROW_PINS[NUM_ROW] = {16, 17, 18, 19};
bool pushed[NUM_ROW][NUM_COL] = {
    {false, false, false, false},
    {false, false, false, false},
    {false, false, false, false},
    {false, false, false, false}};

const char rs = 21, en = 22, d4 = 23, d5 = 25, d6 = 26, d7 = 27;
LiquidCrystal lcd16x2(rs, en, d4, d5, d6, d7);
// DNSServer dnsServer;
AsyncWebServer server(80);
WiFiClient wifiClient;
PubSubClient pubSubClient(wifiClient);
StaticJsonDocument<200> jsonBuffer;
DynamicJsonDocument doc(2048); // Khởi tạo document Jon động với dữ liệu được lưu trong bộ nhớ heap

float findRo(void);
float findRs(void);
int findPPM();

bool initWiFi(void);
bool configWiFiMqtt();
bool debounceButton(char pin);

char readKeypad(void);

void initLcd(void);
void initEpprom(void);
void initSPIFFS(void);
void initPinMode(void);
void setupWiFi(char mode); /*
                          mode=0: on off wifi
                          mode=1: change wifi
                         */
void setupServer(void);
void blink(int f);
void changeWiFi();
void callback(char *topic, byte *payload, unsigned int length);
void reconnect(void);
void sendPPMval(void);
void setPPMThresold(void);
void createJson(void);
void wifiManager(void);
void lcdPrint(char mode); /*
                            mode=0: ganeral
                            mode=1: set PPM Thresold
                            mode=2: on off wifi
                            mode=3: find ro
                            mode=4: change wifi
                          */
void scanNetworks(void);

void setup()
{
  Serial.begin(BAUD_RATE);
  initEpprom();

  previousMillisAlarm = millis();
  initLcd();
  initPinMode();
  initSPIFFS();
  blink(2);
  if (isWiFi)
    setupWiFi(0);
}

void loop()
{

  PPMval = findPPM();
  if (PPMval > PPMThresold)
  {
    if (!isAlarm)
    {
      // nếu như không có bật loa mà trong vòng 5s vẫn vượt ngưỡng thì báo động
      if ((unsigned long)(millis() - previousMillisAlarm) >= 5000)
      {
        isAlarm = true;
        digitalWrite(SPEAKER_PIN, 1);
      }
    }
  }
  lcdPrint(0);
  char keyPressed = readKeypad();
  if (keyPressed != 0)
    Serial.println(keyPressed);

  switch (keyPressed)
  {
  case 'F':
    findRo();
    break;
  case 'S':
    setPPMThresold();
    break;
  case 'W':
    digitalWrite(LED_PIN, 0);
    isWiFi = !isWiFi;
    EEPROM.put(IS_WIFI_ADDRESS, isWiFi);
    delay(5);
    EEPROM.commit();
    delay(5);
    blink(2);
    setupWiFi(0);
    break;
  case 'C':
    digitalWrite(LED_PIN, 0);
    blink(3);
    setupWiFi(1);
    break;
  case 'O':
    isAlarm = false;
    previousMillisAlarm = millis();
    digitalWrite(SPEAKER_PIN, 0);
    break;
  }

  if (WiFi.status() == WL_CONNECTED)
  {
    if (!pubSubClient.connected()) // Kiểm tra kết nối
      reconnect();
    sendPPMval();
    pubSubClient.loop();
  }
}

// class CaptiveRequestHandler : public AsyncWebHandler
// {
// public:
//   CaptiveRequestHandler() {}
//   virtual ~CaptiveRequestHandler() {}

//   bool canHandle(AsyncWebServerRequest *request)
//   {
//     // request->addInterestingHeader("ANY");
//     return true;
//   }

//   void handleRequest(AsyncWebServerRequest *request)
//   {
//     request->send(SPIFFS, "/wifimanager.html", "text/html", false, processor);
//   }
// }
void initEpprom()
{
  EEPROM.begin(EEPROM_SIZE);
  EEPROM.get(SSID_ADDRESS, ssid);
  delay(5);
  EEPROM.get(PASS_ADDRESS, pass);
  delay(5);
  EEPROM.get(INIT_THRESOLD_ADDRESS, initThresold);
  delay(5);
  Serial.println("initThresold: ");
  Serial.println(initThresold);
  if (initThresold)
  {
    Serial.println("init start: ");
    PPMThresold = 1800;
    EEPROM.put(PPMTHRESOLD_VALUE_ADDRESS, PPMThresold);
    delay(5);
    Ro = 3200.0;
    EEPROM.put(RO_VALUE_ADDRESS, Ro);
    delay(5);
    initThresold = false;
    EEPROM.put(INIT_THRESOLD_ADDRESS, initThresold);
    delay(5);
    EEPROM.commit();
    delay(5);
    Serial.println("init DONE");
  }
  EEPROM.get(RO_VALUE_ADDRESS, Ro);
  delay(5);

  EEPROM.get(PPMTHRESOLD_VALUE_ADDRESS, PPMThresold);
  delay(5);

  EEPROM.get(IS_WIFI_ADDRESS, isWiFi);
  delay(5);

  Serial.println();
  Serial.print("ssid: ");
  Serial.println(ssid);
  Serial.print("pass: ");
  Serial.println(pass);
  Serial.print("Ro: ");
  Serial.println(Ro);
  Serial.print("PPM thresold from EEPROM: ");
  Serial.println(PPMThresold);
  Serial.println(isWiFi ? "Online mode" : "Offline mode");
}

void blink(int f)
{
  int delayTime = 1000 / (f * 2);
  for (int i = 0; i < f * 2; i++)
  {
    digitalWrite(LED_PIN, !digitalRead(LED_PIN));
    delay(delayTime);
  }
  digitalWrite(LED_PIN, 0);
}

void initLcd()
{
  lcd16x2.begin(16, 2);
  lcd16x2.clear();
  //   lcd16x2.clear();
  //   lcd16x2.setCursor(1, 0);
  //   lcd16x2.print("He thong nhung");
  //   lcd16x2.setCursor(3, 1);
  //   lcd16x2.print("3119510032");
  //   delay(2000);
  //   lcd16x2.setCursor(3, 1);
  //   lcd16x2.print("3118510057");
  //   delay(2000);
  // }
}
bool initWiFi()
{
  if (ssid == "")
  {
    Serial.println("Undefined SSID or IP address.");
    return false;
  }
  WiFi.mode(WIFI_STA);
  WiFi.begin(ssid.c_str(), pass.c_str());
  lcd16x2.setCursor(0, 1);
  lcd16x2.print("Connecting.....");
  Serial.println("Connecting.....");

  unsigned long currentMillis = millis();
  previousMillis = currentMillis;

  while (WiFi.status() != WL_CONNECTED)
  {
    currentMillis = millis();
    if ((unsigned long)(currentMillis - previousMillis) >= WAIT_FOR_WIFI_CONNECTION_INTERVAL)
    {
      lcd16x2.setCursor(0, 1);
      lcd16x2.print("Failed !        ");
      Serial.println("Failed to connect");
      return false;
    }
  }
  Serial.println("");
  lcd16x2.setCursor(0, 0);
  lcd16x2.print("WiFi connected");
  delay(500);
  return true;
}

void initPinMode()
{

  for (char r = 0; r < NUM_ROW; r++)
  {
    pinMode(ROW_PINS[r], INPUT_PULLUP);
  }
  for (char c = 0; c < NUM_COL; c++)
  {
    pinMode(COL_PINS[c], OUTPUT);
  }
  pinMode(LED_PIN, OUTPUT);
  pinMode(SPEAKER_PIN, OUTPUT);
}

void initSPIFFS()
{
  if (!SPIFFS.begin(true))
  {
    Serial.println("An error has occurred while mounting SPIFFS");
  }
  Serial.println("SPIFFS mounted successfully");
}

void setupServer()
{
  File fileHtml = SPIFFS.open("/wifimanager.html", "r");
  if (fileHtml)
  {
    if (fileHtml.available())
    {
      html = fileHtml.readString();
      Serial.print("SSID form EEPROM: ");
      Serial.println(ssid);
      Serial.print("Password form EEPROM: ");
      Serial.println(pass);
      html.replace("ssidXyz", selectSsid);
      if (pass != "")
      {
        html.replace("passXyz", pass);
      }
    }
    fileHtml.close();
  }
  else
    Serial.println("error on opening file");

  server.on("/", HTTP_GET, [](AsyncWebServerRequest *request)
            { request->send(200, "text/html", html); });

  // Web Server Root URL
  server.serveStatic("/", SPIFFS, "/");

  server.on("/", HTTP_POST, [](AsyncWebServerRequest *request)
            {
    int params = request->params();
    for (int i = 0; i < params; i++)
    {
      AsyncWebParameter *p = request->getParam(i);
      if (p->isPost())
      {
        // HTTP POST ssid value
        if (p->name() == PARAM_INPUT_1)
        {
          ssid = p->value().c_str();
          EEPROM.put(SSID_ADDRESS, ssid);
          delay(5);
          EEPROM.commit();
          delay(5);
          Serial.print("SSID set to: ");
          Serial.println(ssid);
        }
        // HTTP POST pass value
        if (p->name() == PARAM_INPUT_2)
        {
          pass = p->value().c_str();
          EEPROM.put(PASS_ADDRESS, pass);
           delay(5);
          EEPROM.commit();
           delay(5);
          Serial.print("Password set to: ");
          Serial.println(pass);
        }
      }
    }

    request->send(SPIFFS, "/isDone.html", "text/html");
    lcd16x2.clear();
    lcdPrint(2);
    lcd16x2.setCursor(0, 1);
    isWiFiDone = true; });
  server.begin();
}

void scanNetworks()
{
  Serial.println("scan start");
  selectSsid = "<select id='ssid' name='ssid'>";
  selectSsid += "<option value = 'Chọn wifi' selected>Chọn wifi</ option>";
  int n = WiFi.scanNetworks();
  Serial.println("scan done");
  if (n <= 0)
  {
    Serial.println("no networks found");
    selectSsid = "<input type='text' id='ssid' name='ssid' value='" + ssid + "'/>";
  }
  else
  {
    Serial.print(n);
    Serial.println(" networks found");
    for (int i = 0; i < n; ++i)
    {
      Serial.print(i + 1);
      selectSsid += "<option value ='" + WiFi.SSID(i) + "'";
      if (ssid.equals(WiFi.SSID(i)))
        selectSsid += " selected";
      selectSsid += ">" + WiFi.SSID(i) + "</ option>";
      Serial.print(": ");
      Serial.print(WiFi.SSID(i));
      Serial.print(" (");
      Serial.print(WiFi.RSSI(i));
      Serial.print(")");
      Serial.println((WiFi.encryptionType(i) == WIFI_AUTH_OPEN) ? " " : "*");
    }
    selectSsid += "</select>";
  }
}

void wifiManager()
{
  // Connect to Wi-Fi network with SSID and password
  Serial.println("Setting AP (Access Point)");
  // NULL sets an open Access Point
  WiFi.mode(WIFI_AP);
  delay(2000);
  IPAddress IP = WiFi.softAPIP();
  lcd16x2.setCursor(0, 0);
  lcd16x2.print("IP: ");
  lcd16x2.print(IP);
  lcd16x2.print(" ");

  // WiFi.softAPConfig(IP, IP, IPAddress(255, 255, 255, 0));
  WiFi.softAP("WIFI_N11", "123456789");
  // dnsServer.start(DNS_PORT, "*", IP);

  Serial.print("AP IP address: ");
  Serial.println(IP);
  setupServer();
}

void lcdPrint(char mode)
{
  if (mode == 0) // print wifi status, PPM, PPMThresold
  {
    lcd16x2.setCursor(0, 0);
    lcd16x2.print("WiFi: ");

    if (WiFi.status() == WL_CONNECTED)
    {
      digitalWrite(LED_PIN, 1);
      lcd16x2.print("Connected ");
    }
    else
    {
      digitalWrite(LED_PIN, 0);
      lcd16x2.print("Disconnect");
      if (isWiFi == true)
      {
        isWiFi = false;
        EEPROM.put(IS_WIFI_ADDRESS, isWiFi);
        delay(5);
        EEPROM.commit();
        delay(5);
      }
    }
    lcd16x2.setCursor(0, 1);
    lcd16x2.print("PPM: ");
    lcd16x2.print(PPMThresold);
    lcd16x2.print("|");
    lcd16x2.print(PPMval);
    lcd16x2.print("     ");
    return;
  }
  if (mode == 1)
  {
    lcd16x2.setCursor(0, 0);
    lcd16x2.print("Set PPMThresold");
    return;
  }

  if (mode == 2)
  {
    lcd16x2.setCursor(0, 0);
    lcd16x2.print("SETTING WIFI...");
    return;
  }
  if (mode == 3)
  {
    lcd16x2.setCursor(0, 0);
    lcd16x2.print("Finding Ro...");
    return;
  }
}

float findRo()
{
  unsigned char i = 1;
  float RoFinded = 0;
  float Ro = 0;
  lcd16x2.clear();
  lcdPrint(3);
  Serial.println("Finding Ro");
  for (i = 1; i <= CALIBARAION_SAMPLE_TIMES; i++)
  {
    RoFinded += findRs();
    delay(CALIBRATION_SAMPLE_INTERVAL);
  }
  RoFinded = RoFinded / CALIBARAION_SAMPLE_TIMES;
  Serial.println(RoFinded);
  RoFinded = RoFinded / CLEAN_AIR_RAITO;

  Serial.print("Ro finded: ");
  Serial.println(RoFinded);
  EEPROM.put(RO_VALUE_ADDRESS, RoFinded);
  delay(5);
  EEPROM.commit();
  delay(5);
  EEPROM.get(RO_VALUE_ADDRESS, Ro);
  delay(5);
  Serial.print("Ro from EEPROM: ");
  Serial.println(Ro);
  lcd16x2.setCursor(0, 1);
  lcd16x2.print("Ro:");
  lcd16x2.print(Ro);
  delay(2000);
  lcd16x2.clear();
  return RoFinded;
}
float findRs()
{
  float RsFinded = 0;
  float Vmq = ADC_LUT[analogRead(MQ_PIN)];
  RsFinded = ((R6 * RL * VIN) / (Vmq * (R6 + R5))) - RL;
  return RsFinded;
}
int findPPM()
{
  unsigned char i = 1;
  float PPMval = 0;
  float Rs = 0;
  for (i = 1; i <= READ_SAMPLE_INTERVAL; i++)
  {
    Rs += findRs();
    delay(READ_SAMPLE_TIMES);
  }
  Rs = Rs / READ_SAMPLE_INTERVAL;
  PPMval = pow(10, (log10(Rs / Ro) - 1.3307) / -0.479);
  if (PPMval < 300)
    PPMval = 0;
  else if (PPMval > 10000)
    PPMval = 10000;
  return PPMval;
}

void reconnect()
{
  while (!pubSubClient.connected()) // Chờ tới khi kết nối
  {
    // Thực hiện kết nối với mqtt user và pass
    if (pubSubClient.connect("ESP32Client", MQTT_USER, MQTT_PWD)) // kết nối vào broker
    {
      Serial.println("MQTT Broker connected");
      pubSubClient.subscribe("gas/change/PPMThresold");
    }
    else
    {
      Serial.print("Lỗi:, rc=");
      Serial.print(pubSubClient.state());
      Serial.println("Thu lai sau 5s");
      // Đợi 5s
      delay(5000);
    }
  }
}

void sendPPMval()
{
  if ((unsigned long)(millis() - currentTimeSendPPMval) >= SEND_PPM_VALUE_INTERVAL)
  {
    createJson();
    pubSubClient.publish("gas/general", cstr);
    currentTimeSendPPMval = millis();
  }
}

void createJson()
{
  jsonBuffer["PPMval"] = PPMval;
  jsonBuffer["PPMThresold"] = PPMThresold;
  jsonBuffer["isAlarm"] = isAlarm;
  JsonObject rootJson = jsonBuffer.as<JsonObject>();
  serializeJson(rootJson, cstr);
  Serial.println(cstr);
}

// Hàm call back để nhận dữ liệu
void callback(char *topic, byte *payload, unsigned int length)
{
  char pay[255];
  for (int i = 0; i < length; i++)
  {
    pay[i] = 0;
    pay[i] = (char)payload[i];
  }
  Serial.println(pay);
  deserializeJson(doc, pay);             // Khởi tạo một document có kích thước động là 2kb để phân tích chuỗi Json truyền vào
  JsonObject obj = doc.as<JsonObject>(); // Tạo 1 obj có kiểu dữ liệu là JsonObject với document vừa tạo
  byte idtp = obj["idtp"];               // ID Topic

  switch (idtp)
  {
  case 2:
    PPMThresold = obj["PPMThresold"];
    EEPROM.put(PPMTHRESOLD_VALUE_ADDRESS, PPMThresold);
    delay(5);
    EEPROM.commit();
    delay(5);
    createJson();
    pubSubClient.publish("gas/feedback/PPMThresold", (char *)cstr);
    break;
  default:
    break;
  }
}

void setupWiFi(char mode)
{
  isWiFiDone = false;
  if (mode == 0)
  {
    if (isWiFi)
    {
      lcd16x2.clear();
      lcdPrint(2);
      if (!configWiFiMqtt())
      {
        changeWiFi();
      }
      return;
    }

    if (WiFi.status() == WL_CONNECTED)
    {
      WiFi.disconnect();
      pubSubClient.disconnect();
    }
    return;
  }
  if (mode == 1)
  {
    lcd16x2.clear();
    changeWiFi();
  }
  digitalWrite(LED_PIN, 0);
  lcd16x2.clear();
}

bool configWiFiMqtt()
{
  if (initWiFi())
  {
    isWiFi = true;
    pubSubClient.setServer(MQTT_SERVER, MQTT_PORT);
    pubSubClient.setCallback(callback);
    lcd16x2.clear();
    lcd16x2.setCursor(0, 0);
    lcd16x2.print("Setting MQTT...");
    delay(1000);
    reconnect();
    lcd16x2.clear();
    lcd16x2.setCursor(0, 0);
    EEPROM.put(IS_WIFI_ADDRESS, isWiFi);
    delay(5);
    EEPROM.commit();
    delay(5);
    lcd16x2.print("Done!!!");
    isWiFiDone = true;
    delay(1000);
    blink(3);

    return true;
  }
  isWiFi = false;
  EEPROM.put(IS_WIFI_ADDRESS, isWiFi);
  delay(5);
  EEPROM.commit();
  delay(5);
  return false;
}

void changeWiFi()
{
  int counter = 120;
  unsigned long currentMillis = millis();
  unsigned long previousMillis2 = 0;
  previousMillis2 = currentMillis;
  previousMillis = currentMillis;
  lcd16x2.setCursor(0, 0);
  lcd16x2.print("Scanning WIFI...");

  scanNetworks();
  wifiManager();
  lcd16x2.setCursor(0, 1);
  lcd16x2.print("WIFI_N11 | ");
  lcd16x2.print(counter);
  while (isWiFiDone == false)
  {
    char keyPressed = readKeypad();
    if (keyPressed != 0)
      Serial.println(keyPressed);

    if (keyPressed == 'D')
    {
      lcd16x2.setCursor(0, 1);
      lcd16x2.print("Break !!      ");
      delay(1000);
      break;
    }
    currentMillis = millis();
    if ((unsigned long)(currentMillis - previousMillis2) >= 1000)
    {
      counter--;
      previousMillis2 = millis();
      lcd16x2.setCursor(11, 1);
      lcd16x2.print(counter);
      lcd16x2.print("s   ");
      !digitalRead(LED_PIN) ? digitalWrite(LED_PIN, 1) : digitalWrite(LED_PIN, 0);
    }
    if (counter == 0)
    {

      lcd16x2.setCursor(0, 1);
      lcd16x2.print("Failed !      ");
      Serial.println("");
      delay(2000);
      lcd16x2.clear();
      isWiFiDone = true;
      configWiFiMqtt();
      return;
    }
  }
  configWiFiMqtt();
}

void setPPMThresold()
{
  int counter = 120;
  bool blink_lcd = false;
  char digit = 0;
  bool setPPMDone = false;
  char k = 0;
  unsigned long PPMThresold_temp = 0;
  String PPMString;
  lcd16x2.clear();
  lcdPrint(1);
  Serial.println("Set PPMThresold");
  lcd16x2.setCursor(8, 1);
  lcd16x2.print(",");
  lcd16x2.setCursor(0, 1);
  unsigned long currentMillis = millis();
  previousMillis = currentMillis;

  while (setPPMDone == false)
  {
    currentMillis = millis();
    if ((unsigned long)(currentMillis - previousMillis) >= 1000)
    {
      blink_lcd = !blink_lcd;
      counter--;
      previousMillis = currentMillis;
    }
    if (blink_lcd)
    {
      lcd16x2.setCursor(9, 1);
      lcd16x2.print(counter);
      lcd16x2.print("s     ");
    }
    else
    {
      lcd16x2.setCursor(9, 1);
      lcd16x2.print("D: DONE");
    }
    if (counter == 0)
      break;
    k = readKeypad();
    if (k >= '0' && k <= '9' && digit <= 4)
    {
      lcd16x2.setCursor(0, 1);
      PPMString += k;
      Serial.println(k);
      lcd16x2.print(PPMString);
      digit++;
    }
    else if (k == 'D')
    {
      PPMThresold_temp = PPMString.toInt();
      if (PPMThresold_temp >= 300 && PPMThresold_temp <= 10000 && PPMString.length() > 0)
      {
        EEPROM.put(PPMTHRESOLD_VALUE_ADDRESS, PPMThresold_temp);
        delay(5);
        EEPROM.commit();
        delay(5);
        setPPMDone = true;
        Serial.println("Set done");
        Serial.print("Setted PPM thresold: ");
        Serial.println(PPMThresold_temp);
        EEPROM.get(PPMTHRESOLD_VALUE_ADDRESS, PPMThresold);
        delay(5);
        Serial.print("Setted PPM thresold from EEPROM: ");
        Serial.println(PPMThresold);
        lcd16x2.clear();
        lcdPrint(1);
        lcd16x2.setCursor(0, 1);
        lcd16x2.print("DONE: ");
        lcd16x2.print(PPMThresold);
        delay(2000);
      }
      else
      {
        lcd16x2.setCursor(0, 1);
        lcd16x2.print("PPM out of range");
        delay(2000);
        Serial.println("PPM outOf range");
        PPMString = "";
        break;
      }
    }
  }
  blink(2);
  lcd16x2.clear();
}

bool debounceButton(char pin)
{
  int State = 0x0000;
  for (char shift = 0; shift < 16; shift++)
  {
    State = State | digitalRead(pin);
    State = State << 1;
  }
  if (State == 0x0000)
    return true;
  return false;
}

char readKeypad()
{
  char k = 0;
  for (char c = 0; c < NUM_COL; c++)
  {
    digitalWrite(COL_PINS[c], LOW);
    for (char r = 0; r < NUM_ROW; r++)
    {
      if (debounceButton(ROW_PINS[r]) == true && pushed[r][c] == false)
      {
        pushed[r][c] = true;
        k = KEYS[r][c];
      }
      else if (debounceButton(ROW_PINS[r]) == false && pushed[r][c] == true)
      {
        pushed[r][c] = false;
      }
    }
    digitalWrite(COL_PINS[c], HIGH);
  }
  return k;
}